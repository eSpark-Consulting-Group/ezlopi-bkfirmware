## tuya/Projects/BK7231N_TuyaOS-3.9.0/software/TuyaOS/apps/wolf_blinky/Kconfig
```kconfig
###############################################################################
# SPDX-License-Identifier: GPL-3.0-or-later
###############################################################################

mainmenu "MCU App Configuration"

  menu "Application"
    source "ezlopi_user_config/Kconfig"
  endmenu

###############################################################################
```

## tuya/Projects/BK7231N_TuyaOS-3.9.0/software/TuyaOS/apps/wolf_blinky/ezlopi_core/Kconfig
```kconfig
###############################################################################
# SPDX-License-Identifier: GPL-3.0-or-later
###############################################################################

source "ezlopi_core_actions/Kconfig"

###############################################################################
```
